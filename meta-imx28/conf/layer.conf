## meta-imx28/conf/layer.conf
```bitbake
#!/bin/bash
BBPATH := "${BBPATH}:${LAYERDIR}"

BBFILES := "${BBFILES} ${LAYERDIR}/recipes-*/*/*.bb \
				${LAYERDIR}/recipes-*/*/*.bbappend"
BBFILE_COLLECTIONS += "imx28"
BBFILE_PATTERN_imx28 := "^${LAYERDIR}/"
BBFILE_PRIORITY_imx28 = "5"
```
